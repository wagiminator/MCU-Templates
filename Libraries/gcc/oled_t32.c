// ===================================================================================
// SSD1306 128x32 Pixels OLED Functions                                       * v1.0 *
// ===================================================================================
//
// Collection of the most necessary functions for controlling an SSD1306 128x32 pixels
// I2C OLED for the display of text.
//
// References:
// -----------
// - Neven Boyanov:       https://github.com/tinusaur/ssd1306xled
// - Stephen Denne:       https://github.com/datacute/Tiny4kOLED
// - TinyOLEDdemo:        https://github.com/wagiminator/attiny13-tinyoleddemo
// - OLED Font Editor:    http://sourpuss.net/projects/fontedit/
//
// 2022 by Stefan Wagner: https://github.com/wagiminator

#include "oled_t32.h"

// OLED init settings
const uint8_t OLED_INIT_CMD[] = {
  OLED_DISPLAY_OFF,                               // display off
  OLED_CLOCK,      0x80,                          // set oscillator frequency
  OLED_MULTIPLEX,  0x1f,                          // set multiplex ratio for 128x32
  OLED_OFFSET,     0x00,                          // set display offset
  OLED_MEMORYMODE, 0x01,                          // set vertical addressing mode
  OLED_COMPINS,    0x02,                          // set COM pins to sequential
  OLED_PRECHARGE,  0xf1,                          // set pre-charge period
  OLED_CHARGEPUMP, 0x14,                          // enable charge pump
  OLED_YFLIP, OLED_XFLIP,                         // flip screen
  OLED_DISPLAY_ON,                                // display on
};

// Standard ASCII 5x8 font (chars 32 - 127)
const uint8_t OLED_FONT[] = {
  0x00, 0x00, 0x00, 0x00, 0x00, 0x00, 0x00, 0x5F, 0x00, 0x00, 0x00, 0x07, 0x00, 0x07, 0x00,
  0x14, 0x7F, 0x14, 0x7F, 0x14, 0x24, 0x2A, 0x7F, 0x2A, 0x12, 0x23, 0x13, 0x08, 0x64, 0x62,
  0x36, 0x49, 0x55, 0x22, 0x50, 0x00, 0x04, 0x03, 0x00, 0x00, 0x00, 0x1C, 0x22, 0x41, 0x00,
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  0x41, 0x41, 0x36, 0x08, 0x08, 0x08, 0x04, 0x08, 0x10, 0x08, 0xFF, 0xFF, 0xFF, 0xFF, 0xFF
};

// OLED variables
uint8_t OLED_x, OLED_y;                           // current cursor position
const uint16_t DIVIDER[] = {1, 10, 100, 1000, 10000}; // BCD conversion array

// OLED init function
void OLED_init(void) {
  I2C_start(OLED_ADDR);                           // start transmission to OLED
  I2C_write(OLED_CMD_MODE);                       // set command mode
  for (uint8_t i = 0; i < sizeof(OLED_INIT_CMD); i++)
    I2C_write(OLED_INIT_CMD[i]);                  // send the command bytes
  I2C_stop();                                     // stop transmission
}

// OLED set contrast
void OLED_contrast(uint8_t val) {
  I2C_start(OLED_ADDR);                           // start transmission to OLED
  I2C_write(OLED_CMD_MODE);                       // set command mode
  I2C_write(OLED_CONTRAST);                       // contrast command
  I2C_write(val);                                 // set contrast value
  I2C_stop();                                     // stop transmission
}

// OLED set the cursor
void OLED_cursor(uint8_t xpos, uint8_t ypos) {
  xpos &= 0x7F; ypos &= 0x03;                     // limit cursor position values
  I2C_start(OLED_ADDR);                           // start transmission to OLED
  I2C_write(OLED_CMD_MODE);                       // set command mode
  I2C_write(xpos & 0x0F);                         // set low nibble of start column
  I2C_write(0x10 | (xpos >> 4));                  // set high nibble of start column
  I2C_write(0xB0 |  ypos);                        // set start page
  I2C_stop();                                     // stop transmission
  OLED_x = xpos; OLED_y = ypos;                   // set the cursor variables
}

// OLED clear rest of the current line
void OLED_clearLine(void) {
  I2C_start(OLED_ADDR);                           // start transmission to OLED
  I2C_write(OLED_DAT_MODE);                       // set data mode
  while(OLED_x++ < 128) I2C_write(0);             // clear rest of the line
  I2C_stop();                                     // stop transmission
  OLED_setCursor(0, ++OLED_y);                    // set cursor to start of next line
}

// OLED clear screen
void OLED_clear(void) {
  OLED_setCursor(0, 0);                           // set cursor to home position
  for(uint8_t i=4; i; i--) OLED_clearLine();      // clear all 4 lines
}

// OLED plot a single character
void OLED_plotChar(char c) {
  uint16_t ptr = c - 32;                          // character pointer
  ptr += ptr << 2;                                // -> ptr = (ch - 32) * 5;
  I2C_write(0x00);                                // write space between characters
  for (uint8_t i=5 ; i; i--) I2C_write(OLED_FONT[ptr++]);
  OLED_x += 6;                                    // update cursor
  if (OLED_x > 122) {                             // line end ?
    I2C_stop();                                   // stop data transmission
    OLED_setCursor(0,++OLED_y);                   // set next line start
    I2C_start(OLED_ADDR);                         // start transmission to OLED
    I2C_write(OLED_DAT_MODE);                     // set data mode
  }
}

// OLED print a string
void OLED_print(const char* str) {
  I2C_start(OLED_ADDR);                           // start transmission to OLED
  I2C_write(OLED_DAT_MODE);                       // set data mode
  while(*str) OLED_plotChar(*str++);              // plot each character
  I2C_stop();                                     // stop transmission
}

// OLED print a string with new line
void OLED_println(const char* str) {
  OLED_print(str);                                // print the string
  OLED_clearLine();                               // clear rest of the line
}

// OLED print value (BCD conversion by substraction method)
void OLED_printVal(uint16_t value, uint8_t digits, uint8_t decimal, char ch) {
  uint8_t leadflag = 0;                           // flag for leading spaces
  I2C_start(OLED_ADDR);                           // start transmission to OLED
  I2C_write(OLED_DAT_MODE);                       // set data mode
  while(digits--) {                               // for all digits digits
    uint8_t digitval = 0;                         // start with digit value 0
    uint16_t divider = DIVIDER[digits];           // read current divider
    while(value >= divider) {                     // if current divider fits into the value
      leadflag = 1;                               // end of leading spaces
      digitval++;                                 // increase digit value
      value -= divider;                           // decrease value by divider
    }
    if(digits == decimal) leadflag++;             // end leading spaces before decimal
    if(leadflag) OLED_plotChar(digitval + '0');   // print the digit
    else         OLED_plotChar(ch);               // or print leading character
    if(decimal && (digits == decimal)) OLED_plotChar('.');  // print decimal
  }
  I2C_stop();                                     // stop transmission
}
